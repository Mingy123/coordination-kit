## firmware/main/Kconfig.projbuild
```kconfig
menu "USB WebCam config"

    config CAMERA_XCLK_FREQ
        int "XCLK frequency"
        range 1000000 40000000
        default 20000000
        help
            Select XCLK frequency.

    config CAMERA_MODULE_DFR1154
        bool "DFRobot DFR1154 (ESP32-S3 AI Camera — OV3660)"
        default y
        depends on IDF_TARGET_ESP32S3

endmenu
```

## firmware/sdkconfig.defaults
```kconfig
# Partition table
CONFIG_PARTITION_TABLE_CUSTOM=y

# Flash — DFR1154 has W25Q128J (16MB), use 4MB for partition sizing
CONFIG_ESPTOOLPY_FLASHMODE_QIO=y
CONFIG_ESPTOOLPY_FLASHFREQ_80M=y
CONFIG_ESPTOOLPY_FLASHSIZE_4MB=y

# PSRAM — keep for general-purpose use
CONFIG_SPIRAM=y
CONFIG_SPIRAM_MODE_OCT=y
CONFIG_SPIRAM_SPEED_80M=y

# CPU
CONFIG_ESP_DEFAULT_CPU_FREQ_MHZ_240=y
CONFIG_ESP32S3_DEFAULT_CPU_FREQ_240=y

# Console via USB-Serial-JTAG (no UVC competing for USB)
CONFIG_ESP_CONSOLE_USB_SERIAL_JTAG=y

# FreeRTOS
CONFIG_FREERTOS_HZ=1000
```
